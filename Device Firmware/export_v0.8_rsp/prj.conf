## CMakeLists.txt
```
cmake_minimum_required(VERSION 3.13.1)
include($ENV{ZEPHYR_BASE}/cmake/app/boilerplate.cmake NO_POLICY_SCOPE)
project(zephyr-dwm1001)

FILE(GLOB app_sources src/*.c)
target_sources(app PRIVATE ${app_sources})

FILE(GLOB ble_sources src/BLE/*.c)
target_sources(app PRIVATE ${ble_sources})

FILE(GLOB uwb_sources src/UWB/*.c)
target_sources(app PRIVATE ${uwb_sources})

FILE(GLOB i2c_sources src/I2C/*.c)
target_sources(app PRIVATE ${i2c_sources})

target_sources(app PRIVATE ../../decadriver/deca_device.c)
target_sources(app PRIVATE ../../decadriver/deca_params_init.c)

target_sources(app PRIVATE ../../platform/port.c)
target_sources(app PRIVATE ../../platform/deca_mutex.c)
target_sources(app PRIVATE ../../platform/deca_range_tables.c)
target_sources(app PRIVATE ../../platform/deca_sleep.c)
target_sources(app PRIVATE ../../platform/deca_spi.c)


target_include_directories(app PRIVATE ../../decadriver/)
target_include_directories(app PRIVATE ../../platform/)
target_include_directories(app PRIVATE ../../compiler/)

zephyr_library_include_directories($ENV{ZEPHYR_BASE}/samples/bluetooth)
```

## prj.conf
```kconfig
CONFIG_SPI=y
CONFIG_SPI_1=y
CONFIG_SPI_1_NRF_SPIM=y

CONFIG_PRINTK=y

CONFIG_NEWLIB_LIBC=y
CONFIG_FLOAT=y

## IC2 SENSORS
CONFIG_SENSOR=y
CONFIG_I2C=y
CONFIG_LIS2DH=y

# BLUETOOTH
CONFIG_SYSTEM_WORKQUEUE_STACK_SIZE=2048
CONFIG_BT=y
CONFIG_BT_DEBUG_LOG=y
CONFIG_BT_SMP=y
CONFIG_BT_SIGNING=y
CONFIG_BT_PERIPHERAL=y
CONFIG_BT_BROADCASTER=y
CONFIG_BT_OBSERVER=y
CONFIG_BT_GATT_DIS=y
CONFIG_BT_ATT_PREPARE_COUNT=2
CONFIG_BT_PRIVACY=y
CONFIG_BT_DEVICE_NAME="Custom BLE Example"
CONFIG_BT_DEVICE_APPEARANCE=833
CONFIG_BT_DEVICE_NAME_DYNAMIC=y
CONFIG_BT_DEVICE_NAME_MAX=65
CONFIG_BT_SETTINGS=y
CONFIG_FLASH=y
CONFIG_FLASH_PAGE_LAYOUT=y
CONFIG_FLASH_MAP=y
CONFIG_FCB=y
CONFIG_SETTINGS=y
CONFIG_SETTINGS_FCB=y
```

## src/main.c
```c
#include <zephyr.h>
#include "UWB/uwb.h"
#include "BLE/ble_main.h"
#include "I2C/accelerometer.h"


#include "random/rand32.h"

#define STACKSIZE 1024
char thread_stacks[3][STACKSIZE];
static struct k_thread threads[3];

#define APP_HEADER "\nDWM1001 & Zephyr\n"
#define APP_NAME "Export_v0.8_rsp\n"
#define APP_VERSION "Version - 1.4.0\n"
#define APP_VERSION_NUM 0x010400
#define APP_LINE "=================\n"


void thread_2(void *arg1, void *ard2, void *arg3)
{
    while(1)
    {
        printk("Second Thread \n");
        Sleep(1500);
    }
}

int main(void)
{
    printk(APP_HEADER);
    printk(APP_NAME);
    printk(APP_VERSION);
    printk(APP_LINE);

    k_thread_create(&threads[0], &thread_stacks[0][0], STACKSIZE, ble_thread, 0, 0, 0, 3, 0, 0);
    k_thread_create(&threads[1], &thread_stacks[1][0], STACKSIZE, uwb_thread, 0, 0, 0, 4, 0, 0);
    //k_thread_create(&threads[2], &thread_stacks[2][0], STACKSIZE, acc_thread, 0, 0, 0, K_PRIO_COOP(4), 0, 0);
    
    // while(1)
    // {
    //     // rand_val = mask & sys_rand32_get();
    //     // //rand_val = rand_val >> 23;
    //     // printk("%u \n", rand_val);
    //     // k_sleep(1000);
    // }
}
```
